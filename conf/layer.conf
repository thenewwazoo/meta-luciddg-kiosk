## conf/layer.conf
```bitbake
BBPATH .= ":${LAYERDIR}"

BBFILES += "${LAYERDIR}/recipes-*/*/*.bb \
            ${LAYERDIR}/recipes-*/*/*.bbappend"

BBFILE_COLLECTIONS += "meta-luciddg-kiosk"
BBFILE_PATTERN_meta-luciddg-kiosk := "^${LAYERDIR}/"
BBFILE_PRIORITY_meta-luciddg-kiosk = "6"

LAYERSERIES_COMPAT_meta-luciddg-kiosk = "sumo"
```
